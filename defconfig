## defconfig
```kconfig
CONFIG_ARCH="sim"
CONFIG_ARCH_BOARD="sim"
CONFIG_ARCH_BOARD_SIM=y
CONFIG_ARCH_CHIP="sim"
CONFIG_ARCH_SIM=y
CONFIG_BOARD_LATE_INITIALIZE=y
CONFIG_DRIVERS_VIDEO=y
CONFIG_EXAMPLES_DIRECTFB=y
CONFIG_GRAPHICS_DIRECTFB2=y
CONFIG_INIT_ENTRYPOINT="directfb_main"
CONFIG_PTHREAD_CLEANUP=y
CONFIG_PTHREAD_MUTEX_TYPES=y
CONFIG_SIM_FBHEIGHT=480
CONFIG_SIM_FBWIDTH=640
CONFIG_SIM_X11FB=y
CONFIG_VIDEO_FB=y
```

## lib/direct/os/nuttx/configs/stm32f429i-disco/defconfig
```kconfig
# CONFIG_STM32_FB_CMAP is not set
CONFIG_ARCH="arm"
CONFIG_ARCH_BOARD="stm32f429i-disco"
CONFIG_ARCH_BOARD_STM32F429I_DISCO=y
CONFIG_ARCH_BUTTONS=y
CONFIG_ARCH_CHIP="stm32"
CONFIG_ARCH_CHIP_STM32F429Z=y
CONFIG_ARCH_IRQBUTTONS=y
CONFIG_BUILTIN=y
CONFIG_DRIVERS_VIDEO=y
CONFIG_EXAMPLES_DIRECTFB=y
CONFIG_EXAMPLES_DIRECTFB_FONT_EXTENSION="ttf"
CONFIG_EXAMPLES_DIRECTFB_FONT_PROVIDER="STB"
CONFIG_EXAMPLES_DIRECTFB_IMAGE_EXTENSION="png"
CONFIG_EXAMPLES_DIRECTFB_IMAGE_PROVIDER="STB"
CONFIG_EXAMPLES_DIRECTFB_VIDEO_EXTENSION="mpg"
CONFIG_EXAMPLES_DIRECTFB_VIDEO_PROVIDER="PLM"
CONFIG_GRAPHICS_DIRECTFB2=y
CONFIG_GRAPHICS_DIRECTFB2_MEDIA_PL_MPEG=y
CONFIG_GRAPHICS_DIRECTFB2_MEDIA_STB=y
CONFIG_HEAP2_BASE=0xD0000000
CONFIG_HEAP2_SIZE=7774208
CONFIG_INIT_ENTRYPOINT="nsh_main"
CONFIG_INPUT=y
CONFIG_INPUT_BUTTONS=y
CONFIG_INPUT_BUTTONS_LOWER=y
CONFIG_INPUT_STMPE811=y
CONFIG_MM_REGIONS=2
CONFIG_NSH_ARCHINIT=y
CONFIG_NSH_BUILTIN_APPS=y
CONFIG_PIPES=y
CONFIG_PTHREAD_CLEANUP_STACKSIZE=1
CONFIG_PTHREAD_MUTEX_TYPES=y
CONFIG_RAW_BINARY=y
CONFIG_SCHED_HPWORK=y
CONFIG_STM32F429I_DISCO_ILI9341=y
CONFIG_STM32_CCMEXCLUDE=y
CONFIG_STM32_EXTERNAL_RAM=y
CONFIG_STM32_FMC=y
CONFIG_STM32_I2C3=y
CONFIG_STM32_LTDC=y
CONFIG_STM32_LTDC_FB_BASE=0xD076A000
CONFIG_STM32_LTDC_FB_SIZE=307200
CONFIG_STM32_USART1=y
CONFIG_STMPE811_ACTIVELOW=y
CONFIG_STMPE811_EDGE=y
CONFIG_STMPE811_OFFSETX=300
CONFIG_STMPE811_OFFSETY=242
CONFIG_STMPE811_THRESHX=15
CONFIG_STMPE811_THRESHY=11
CONFIG_STMPE811_SWAPXY=y
CONFIG_SYSTEM_NSH=y
CONFIG_USART1_SERIAL_CONSOLE=y
CONFIG_VIDEO_FB=y
```
